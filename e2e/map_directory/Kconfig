## e2e/map_directory/Kconfig
```kconfig
mainmenu "map_directory compiler capability fixture"

comma := ,
if-success = $(shell,{ $(1); } >/dev/null 2>&1 && echo "$(2)" || echo "$(3)")
success = $(if-success,$(1),y,n)
cc-option = $(success,$(CC) -Werror $(CLANG_FLAGS) $(1) -c -x c /dev/null -o /dev/null)

cc-info := $(shell,$(srctree)/scripts/cc-version.sh $(CC))
$(error-if,$(success,test -z "$(cc-info)"),Sorry$(comma) this C compiler is not supported.)
cc-name := $(shell,set -- $(cc-info) && echo $1)
cc-version := $(shell,set -- $(cc-info) && echo $2)

as-info := $(shell,$(srctree)/scripts/as-version.sh $(CC) $(CLANG_FLAGS))
$(error-if,$(success,test -z "$(as-info)"),Sorry$(comma) this assembler is not supported.)
as-name := $(shell,set -- $(as-info) && echo $1)
as-version := $(shell,set -- $(as-info) && echo $2)

ld-info := $(shell,$(srctree)/scripts/ld-version.sh $(LD))
$(error-if,$(success,test -z "$(ld-info)"),Sorry$(comma) this linker is not supported.)
ld-name := $(shell,set -- $(ld-info) && echo $1)
ld-version := $(shell,set -- $(ld-info) && echo $2)

config 64BIT
	def_bool y

config X86
	def_bool 64BIT

config X86_64
	def_bool X86 && 64BIT

config CC_IS_GCC
	def_bool $(success,test "$(cc-name)" = GCC)

config GCC_VERSION
	int
	default $(cc-version) if CC_IS_GCC
	default 0

config CC_IS_CLANG
	def_bool $(success,test "$(cc-name)" = Clang)

config CLANG_VERSION
	int
	default $(cc-version) if CC_IS_CLANG
	default 0

config AS_IS_GNU
	def_bool $(success,test "$(as-name)" = GNU)

config AS_IS_LLVM
	def_bool $(success,test "$(as-name)" = LLVM)

config AS_VERSION
	int
	default $(as-version)

config LD_IS_BFD
	def_bool $(success,test "$(ld-name)" = BFD)

config LD_IS_LLD
	def_bool $(success,test "$(ld-name)" = LLD)

config LD_VERSION
	int
	default $(ld-version) if LD_IS_BFD
	default 0

config LLD_VERSION
	int
	default $(ld-version) if LD_IS_LLD
	default 0

config MAP_DIRECTORY_CC_SUPPORTED
	def_bool $(cc-option,-fno-omit-frame-pointer)

config MAP_DIRECTORY_CC_UNSUPPORTED
	def_bool $(cc-option,-fno-linux-bzl-map-directory-spike)

config MAP_DIRECTORY_CLANG_SELECTED
	def_bool CC_IS_CLANG && CLANG_VERSION = 220108 && AS_IS_LLVM && AS_VERSION = 0 && LD_IS_LLD && LLD_VERSION = 220108

config MAP_DIRECTORY_GCC_SELECTED
	def_bool CC_IS_GCC && GCC_VERSION = 150200 && AS_IS_GNU && AS_VERSION = 24600 && LD_IS_BFD && LD_VERSION = 24600
```

## internal/tests/mapped_kernel/Kconfig
```kconfig
mainmenu "mapped kernel smoke"

config X86
    bool
    default y

config X86_64
    bool
    default y

config FRAME_WARN
    int
    default 2048

config CC_VERSION_TEXT
    string
    default "$(CC_VERSION_TEXT)"

config UNUSED_FAMILY_OPTION
    bool "Unused family option"
    default n

config USED_FAMILY_OPTION
    bool "Used family option"
    default n
```

## internal/tests/resolved_config/Kconfig
```kconfig
mainmenu "linux.bzl resolved config test"

config X86
	bool "x86"

config X86_64
	bool "x86-64"

config ARM64
	bool "arm64"

config 64BIT
	bool
	default y

config RUST
	bool "Rust support"
	default n

config RUSTC_VERSION
	int
	default 107800
```

## tests/compact/Kconfig
```kconfig
mainmenu "Compact generator fixture"

config MODULES
	tristate "Modules"
	modules

config NET
	tristate "Networking"

config DEBUG
	bool "Debug"

config FORCE_NET
	bool "Force networking"
	select NET

config PCI
	bool "PCI"

config DRIVER
	tristate "Driver"
	depends on NET && PCI

config EXTRA_CFLAGS
	bool "Extra compiler flags"
```

## tests/map_directory/Kconfig
```kconfig
mainmenu "map_directory compiler capability fixture"

if-success = $(shell,{ $(1); } >/dev/null 2>&1 && echo "$(2)" || echo "$(3)")
success = $(if-success,$(1),y,n)
cc-option = $(success,$(CC) -Werror $(CLANG_FLAGS) $(1) -c -x c /dev/null -o /dev/null)

config 64BIT
	def_bool y

config X86
	def_bool 64BIT

config X86_64
	def_bool X86 && 64BIT

config MAP_DIRECTORY_CC_SUPPORTED
	def_bool $(cc-option,-fno-omit-frame-pointer)

config MAP_DIRECTORY_CC_UNSUPPORTED
	def_bool $(cc-option,-fno-linux-bzl-map-directory-spike)
```
